/*
 * Copyright 2026, Skykraft
 *
 * SPDX-License-Identifier: GPL-2.0-only
 */

/ {
	memory@0 {
		device_type = "memory";
		reg = <0x00 0x00 0x00 0x7ff00000 0x08 0x00 0x00 0x80000000>;
	};

    chosen {
		seL4,kernel-devices =
		    "serial1",
		    &{/amba_apu@0/interrupt-controller@f9010000},
		    &{/timer},
		    &{/amba/smmu@fd800000};
    };
};
